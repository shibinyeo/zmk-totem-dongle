## config/west.yml
```yaml
manifest:
  remotes:
    - name: zmkfirmware
      url-base: https://github.com/zmkfirmware
    - name: petejohanson
      url-base: https://github.com/petejohanson
  projects:
    - name: zmk
      remote: zmkfirmware
      revision: main
      import: app/west.yml
    - name: zmk-mouse
      remote: petejohanson
      repo-path: zmk
      revision: feat/pointers-move-scroll
      import: app/west.yml
  self:
    path: config
```
